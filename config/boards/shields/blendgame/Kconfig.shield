## config/boards/shields/blendgame/Kconfig.shield
```kconfig
# Copyright (c) 2021 The ZMK Contributors
# SPDX-License-Identifier: MIT

config SHIELD_BLENDGAME
    def_bool $(shields_list_contains,blendgame)
```
